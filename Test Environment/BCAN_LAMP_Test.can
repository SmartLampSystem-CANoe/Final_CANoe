/*@!Encoding:65001*/
includes
{
  
}

variables
{
  message BCAN_DB::MSG_VehicleSpeedInfo msg_BVehicleSpeedInfo;
  message PCAN_DB::MSG_VehicleSpeedInfo msg_PVehicleSpeedInfo;
  byte data[1];
  dword crc;
  dword match;
  int i, j;
}

testcase DirLampCtrl(){
  //int k;
  message BCAN_DB::MSG_DirLampCtrl msg_dirlampCTR;
  msg_dirlampCTR.dlc = 8;
  msg_dirlampCTR.rtr = 0;
  msg_dirlampCTR.can = 3;
  
  for(i=1; i>=0; i--){
    for(j=1; j>=0; j--){
        msg_dirlampCTR.SIG_IndicatorState.phys = 1; 
        msg_dirlampCTR.SIG_IndicatorDir.phys = i; 
        msg_dirlampCTR.SIG_IndicatorTime.phys = j;
        output(msg_dirlampCTR);
        testWaitForTimeout(100);
        testValidateSignalMatch("", SIG_IndicatorDir, @Lamp::SYSVAR_IndicatorDir);       
    }
  }
  for(i=1; i>=0; i--){
    for(j=1; j>=0; j--){
        msg_dirlampCTR.SIG_IndicatorState.phys = 0; 
        msg_dirlampCTR.SIG_IndicatorDir.phys = i; 
        msg_dirlampCTR.SIG_IndicatorTime.phys = j;
        output(msg_dirlampCTR);
        testWaitForTimeout(100);
        testValidateSignalMatch("", SIG_IndicatorDir, @Lamp::SYSVAR_IndicatorDir);
        
        testValidateSignalMatch("", sysvar::Lamp::SYSVAR_LeftDirLamp, 0);
        testValidateSignalMatch("", sysvar::Lamp::SYSVAR_RightDirLamp, 0);
    }
  }
        
 
}
testcase HarzardLightCtrl(){
  //int k;
  message can3.BCAN_DB::MSG_HarzardLightCtrl msg_hzrdLCTR;
  msg_hzrdLCTR.dlc = 8;
  msg_hzrdLCTR.rtr = 0;
  msg_hzrdLCTR.can = 3;
  
  msg_hzrdLCTR.SIG_HarzardLightBtn.phys = 1;
  output(msg_hzrdLCTR);
  testWaitForTimeout(100);
  //toggle check
  
  msg_hzrdLCTR.SIG_HarzardLightBtn.phys = 0;
  output(msg_hzrdLCTR);
  testWaitForTimeout(100);
  testValidateSignalMatch("", SIG_HarzardLightBtn, @Lamp::SYSVAR_HarzardLight);
        
}

testcase HLBeamCtrl(){
  int arr[7] = {0, 1, 2, 5, 6, 9 ,10};
  
  message can3.BCAN_DB::MSG_HLBeamCtrl msg_hlbCTR;
  msg_hlbCTR.dlc = 8;
  msg_hlbCTR.rtr = 0;
  msg_hlbCTR.can = 3;
    
  for(i=6;i>=0;i--){     
    for(j=0; j<4; j++){
    msg_hlbCTR.SIG_HLBeamMode.phys = arr[i]; //and 1, 2, 5, 6, 9, 10
    msg_hlbCTR.SIG_HBeamAngle.phys = j;
    output(msg_hlbCTR);
    testWaitForTimeout(500);
    testValidateSignalMatch("", SIG_HLBeamMode, @Lamp::SYSVAR_FLampMode);
    testValidateSignalMatch("", SIG_HBeamAngle, @Lamp::SYSVAR_HBeamAngle);     
    }
  }
}

testcase LBeamAutoAngleCtrl(){
  message can3.BCAN_DB::MSG_LBeamAutoAngleCtrl msg_lbaaCTL;
  msg_lbaaCTL.dlc = 8;
  msg_lbaaCTL.rtr = 0;
  msg_lbaaCTL.can = 3;
  
      msg_lbaaCTL.SIG_AutoLowBeamAngleBtn.phys = 0; 
      @Lamp::SYSVAR_AutoLBeamAngleState = 1;
      output(msg_lbaaCTL);
      testWaitForTimeout(100);
      testValidateSignalMatch("", sysvar::Lamp::SYSVAR_AutoLBeamAngleState, 0);
  
      for(i=36; i<200; i+=40){
      msg_lbaaCTL.SIG_AutoLowBeamAngleBtn.phys = 1; 
      @Lamp::SYSVAR_AutoLBeamAngleState = 0;
      @Lamp::SYSVAR_VehicleSpeed = i;
      output(msg_lbaaCTL);
      testWaitForTimeout(100);
      testValidateSignalMatch("", sysvar::Lamp::SYSVAR_AutoLBeamAngleState, 1);
    }
}
testcase BrakePedalInfo(){
  
  message CCAN_DB::MSG_BrakePedalInfo msg_CBrakePedalInfo; //Intergration Test
  message BCAN_DB::MSG_VehicleSpeedInfo msg_BVehicleSpeedInfo;
  msg_CBrakePedalInfo.can = 2; msg_BVehicleSpeedInfo.can = 3;
  msg_CBrakePedalInfo.dlc = 2; msg_BVehicleSpeedInfo.can = 2;
  msg_CBrakePedalInfo.rtr = 0; msg_BVehicleSpeedInfo.can = 0;
  for(i=50; i<0; i-=10){
    for(j=1; j<0; j--){
      msg_CBrakePedalInfo.SIG_BrakePedalPos.phys = i;
      msg_CBrakePedalInfo.SIG_BrakePedalPress.phys = j;
        output(msg_CBrakePedalInfo);
        testWaitForTimeout(100);
        output(msg_BVehicleSpeedInfo);
        testWaitForTimeout(100);
        testValidateSignalMatch("", SIG_BrakePedalState, @Lamp::SYSVAR_BrakeLamp);
    }
  }
  
}


void MainTest(){
  BrakePedalInfo();
  DirLampCtrl();
  LBeamAutoAngleCtrl();
  HarzardLightCtrl();
  HLBeamCtrl();
}