/*@!Encoding:65001*/
includes
{
    #include "forward.cin"
}
variables
{
    message PCAN_DB::MSG_AccEngineCtrl   msg_AccEngineCtrl;
    message BCAN_DB::MSG_ObjectDetection msg_ObjectDetection;
    msTimer t_5ms;
    msTimer t_500ms;
}

on start
{
    setTimerCyclic(t_5ms, 5);
    setTimerCyclic(t_500ms, 500);
}

on timer t_5ms
{
    forwardMsg(msg_AccEngineCtrl, 1);
}

on timer t_500ms
{
    forwardMsg(msg_ObjectDetection, 3);
}

on message can4.ADAS_DB::MSG_AccEngineCtrl
{
    // CRC check
    byte data[5];
    data[4] = this.byte(1);
    data[3] = this.byte(2);
    data[2] = this.byte(3);
    data[1] = this.byte(4);
    data[0] = this.byte(5);
    if (checkCRC(this, data) == 0)
    {
        write("CAN%d.%s Error: Unmatched CRC", this.can, this.name);
        return; 
    }

    // data range check
    if ((this.SIG_AccMode != 0) && (this.SIG_AccMode != 1))
    {
        write("CAN%d.%s Error: Invalid Data", this.can, this.name);
        return;
    }
    
    if ((this.SIG_EnginePower > 150.0) || (this.SIG_EnginePower < 0.0))
    {
        write("CAN%d.%s Error: Invalid Data", this.can, this.name);
        return;
    }
    
    {
        int i;
        for (i = 0; i < this.dlc; i++)
        {
            msg_AccEngineCtrl.byte(i) = this.byte(i);
        }
    }
}

on message can4.ADAS_DB::MSG_ObjectDetection
{
    // CRC check
    byte data[1];
    data[0] = this.byte(1);
    if (checkCRC(this, data) == 0)
    {
        write("CAN%d.%s Error: Unmatched CRC", this.can, this.name);
        return; 
    }

    // data range check
    if ((this.SIG_PrecedingCarPos < 0) && (this.SIG_PrecedingCarPos > 3))
    {
        write("CAN%d.%s Error: Invalid Data", this.can, this.name);
        return;
    }
    
    msg_ObjectDetection.SIG_Crc = this.SIG_Depending;
    msg_ObjectDetection.SIG_PrecedingCarPos = this.SIG_PrecedingCarPos;
}