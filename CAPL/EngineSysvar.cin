/*@!Encoding:65001*/

variables
{
}

on sysvar Engine::SYSVAR_AccelPedalPos
{
    @Engine::SYSVAR_AccelPedalState = (@this > 0) ? 1 : 0;
}