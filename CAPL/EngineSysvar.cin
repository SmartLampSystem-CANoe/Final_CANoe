/*@!Encoding:65001*/

variables
{
    mstimer timer_100ms;
}

on start
{
    setTimerCyclic(timer_100ms, 100);    
}

/*
on timer timer_100ms
{
    if (@Engine::SYSVAR_AccelPedalPos > @Brake::SYSVAR_BrakePedalPos)
    {
        @Engine::SYSVAR_VehicleSpeed += (int)((@Engine::SYSVAR_AccelPedalPos - @Brake::SYSVAR_BrakePedalPos) / 20.0);
    }
    else if (@Engine::SYSVAR_AccelPedalPos < @Brake::SYSVAR_BrakePedalPos)
    {
        @Engine::SYSVAR_VehicleSpeed -= (int)((@Brake::SYSVAR_BrakePedalPos - @Engine::SYSVAR_AccelPedalPos) / 10.0);
    }
    else
    {
        @Engine::SYSVAR_VehicleSpeed--;
    }
    
    @Engine::SYSVAR_VehicleSpeed = (@Engine::SYSVAR_VehicleSpeed > 250) ? 250 : @Engine::SYSVAR_VehicleSpeed;
    @Engine::SYSVAR_VehicleSpeed = (@Engine::SYSVAR_VehicleSpeed < 0) ? 0 : @Engine::SYSVAR_VehicleSpeed;
}
*/

on sysvar Engine::SYSVAR_AccelPedalPos
{
    @Engine::SYSVAR_AccelPedalState = (@this > 0) ? 1 : 0;
}