/*@!Encoding:65001*/

void sendVehicleSpeedInfo(void)
{
    message PCAN_DB::MSG_VehicleSpeedInfo msg;
    byte data[1];
    dword crc;
    
    msg.can = 1;
    msg.SIG_VehicleSpeed = @Engine::SYSVAR_VehicleSpeed;
    
    data[0] = msg.byte(1);
    
    Crc_CalculateCRC8(data, elcount (data), 0, elcount (data), 0, 1, crc);
    msg.SIG_Crc = crc;
    
    output(msg);
}

void sendAccelPedalInfo(void)
{
    message PCAN_DB::MSG_AccelPedalInfo msg;
    byte data[1];
    dword crc;
    
    msg.can = 1;
    msg.SIG_AccelPedalPos   = @Engine::SYSVAR_AccelPedalPos;
    msg.SIG_AccelPedalState = @Engine::SYSVAR_AccelPedalState;
    
    data[0] = msg.byte(1);
    
    Crc_CalculateCRC8(data, elcount (data), 0, elcount (data), 0, 1, crc);
    msg.SIG_Crc = crc;
    
    output(msg);
}