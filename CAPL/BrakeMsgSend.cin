/*@!Encoding:65001*/

void sendBrakePedalInfo(void)
{
    message CCAN_DB::MSG_BrakePedalInfo msg;
    byte data[1];
    dword crc;
    
    msg.can = 2;
    msg.SIG_BrakePedalPos   = @sysvar::Brake::SYSVAR_BrakePedalPos;
    msg.SIG_BrakePedalPress = @sysvar::Brake::SYSVAR_BrakePedalState;
    
    data[0] = msg.byte(1);
    
    Crc_CalculateCRC8(data, elcount (data), 0, elcount (data), 0, 1, crc);
    msg.SIG_Crc = crc;
    
    output(msg);
}