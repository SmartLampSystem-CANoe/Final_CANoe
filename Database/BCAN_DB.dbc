VERSION ""

NS_ :

BS_:

BU_: BGW Lamp

BO_ 1280 msg_SteeringInfo: 3 BGW
 SG_ sig_SteeringWheelAngle : 8|11@1- (1,0) [-540|540] "degree"  Lamp
 SG_ sig_CRC : 0|8@1- (1,0) [0|0] ""  Lamp

BO_ 1024 msg_BrakeInfo: 2 BGW
 SG_ sig_BrakePedalPress : 8|1@1+ (1,0) [0|1] ""  Lamp
 SG_ sig_CRC : 0|8@1- (1,0) [0|0] ""  Lamp

BO_ 768 msg_VehicleSpeedInfo: 2 BGW
 SG_ sig_VehicleSpeed : 8|8@1+ (1,0) [0|200] "km/h"  Lamp
 SG_ sig_CRC : 0|8@1- (1,0) [0|0] ""  Lamp

BA_DEF_  "DatabaseVersion" STRING ;
BA_DEF_  "Manufacturer" STRING ;
BA_DEF_  "BusType" STRING ;
BA_DEF_ SG_  "GenSigSendType" ENUM  "Cyclic","OnWrite","OnWriteWithRepetition","OnChange","OnChangeWithRepetition","IfActive","IfActiveWithRepetition","NoSigSendType","NotUsed","NotUsed","NotUsed","NotUsed","NotUsed";
BA_DEF_ BO_  "GenMsgSendType" ENUM  "Cyclic","NotUsed","NotUsed","NotUsed","NotUsed","Cyclic","NotUsed","IfActive","NoMsgSendType","NotUsed","vector_leerstring";
BA_DEF_ BO_  "GenMsgCycleTime" INT 0 50000;
BA_DEF_ BO_  "GenMsgCycleTimeFast" INT 0 50000;
BA_DEF_ BO_  "GenMsgILSupport" ENUM  "No","Yes";
BA_DEF_DEF_  "DatabaseVersion" "";
BA_DEF_DEF_  "Manufacturer" "Vector";
BA_DEF_DEF_  "BusType" "CAN";
BA_DEF_DEF_  "GenSigSendType" "Cyclic";
BA_DEF_DEF_  "GenMsgSendType" "NoMsgSendType";
BA_DEF_DEF_  "GenMsgCycleTime" 200;
BA_DEF_DEF_  "GenMsgCycleTimeFast" 20;
BA_DEF_DEF_  "GenMsgILSupport" "Yes";
BA_ "DatabaseVersion" "1.1";
BA_ "GenSigSendType" SG_ 1280 sig_SteeringWheelAngle 7;
BA_ "GenSigSendType" SG_ 1280 sig_CRC 7;
BA_ "GenSigSendType" SG_ 1024 sig_BrakePedalPress 7;
BA_ "GenSigSendType" SG_ 1024 sig_CRC 7;
BA_ "GenSigSendType" SG_ 768 sig_VehicleSpeed 7;
BA_ "GenSigSendType" SG_ 768 sig_CRC 7;
